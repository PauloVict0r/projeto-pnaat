## sample_project/sdkconfig.defaults
```kconfig
CONFIG_ESP_SYSTEM_EVENT_TASK_STACK_SIZE=32768
CONFIG_ESP_MAIN_TASK_STACK_SIZE=65536
CONFIG_COMPILER_OPTIMIZATION_PERF=y
CONFIG_COMPILER_OPTIMIZATION_DEFAULT=n
```
